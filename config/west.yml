## config/west.yml
```yaml
manifest:
  remotes:
    - name: zmkfirmware
      url-base: https://github.com/zmkfirmware
  projects:
    - name: zmk
      remote: zmkfirmware
      # Pinned to last ZMK release before Zephyr 4.1 / Hardware Model v2.
      # The Hillside shield definitions in this repo are not yet HWMv2-compatible.
      revision: v0.3
      import: app/west.yml
  self:
    path: config
```
